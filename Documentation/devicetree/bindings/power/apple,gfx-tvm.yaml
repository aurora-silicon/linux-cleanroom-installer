## Documentation/devicetree/bindings/power/apple,gfx-tvm.yaml
```yaml
# SPDX-License-Identifier: (GPL-2.0-only OR BSD-2-Clause)
%YAML 1.2
---
$id: http://devicetree.org/schemas/power/apple,gfx-tvm.yaml#
$schema: http://devicetree.org/meta-schemas/core.yaml#

title: Apple T8132 outer graphics TVM power gate

maintainers:
  - Eryk Wieliczko <eryk@wieliczko.ninja>

description: |
  Single-register outer graphics gate. The PMGR GFX domain is its child;
  the inner AGX PMP vote is a separate firmware-owned control. Only bit 0
  is changed by this provider, preserving the remaining register state.

allOf:
  - $ref: power-domain.yaml#

properties:
  compatible:
    const: apple,t8132-gfx-tvm
  reg:
    maxItems: 1
  "#power-domain-cells":
    const: 0

required:
  - compatible
  - reg
  - "#power-domain-cells"

additionalProperties: false

examples:
  - |
    soc {
        #address-cells = <2>;
        #size-cells = <2>;
        power-controller@380760800 {
            compatible = "apple,t8132-gfx-tvm";
            reg = <0x3 0x80760800 0x0 0x4>;
            #power-domain-cells = <0>;
        };
    };
```

## drivers/gpu/drm/apple/Kconfig
```kconfig
# SPDX-License-Identifier: GPL-2.0-only OR MIT
config DRM_APPLE_M4_READY
	tristate "J713 internal DCP transport qualification"
	depends on DRM && ARM64 && OF && APPLE_RTKIT && APPLE_DART
	depends on APPLE_PMP
	depends on BACKLIGHT_CLASS_DEVICE
	select DRM_KMS_HELPER
	select DRM_GEM_SHMEM_HELPER
	select DRM_CLIENT_SELECTION
	select APERTURE_HELPERS
	help
	  Qualification of the inherited J713 internal DCP, with an opt-in
	  fixed-mode diagnostic scanout and separately triggered native atomic KMS.
	  KMS takes over the inherited framebuffer only after a completed scanout.
	  The explicitly triggered transport session
	  and its DMA storage stay pinned until reboot; unloading is unsupported.
	  This is an intermediate bring-up driver, not a desktop display driver.
	  May be built alongside DRM_APPLE: this driver binds only
	  apple,t8132-dcp on J713, which DRM_APPLE does not match.

config DRM_APPLE_M4_GPU_POWER
	tristate "J713 GPU power admission experiment"
	depends on DRM && ARM64 && OF && APPLE_GFX_TVM && APPLE_PMP && APPLE_RTKIT
	select CRYPTO_LIB_SHA256
	select DRM_APPLE_M4_GPU
	help
	  Explicitly enabled, retained outer GFX power and stopped-ASC check,
	  followed by a separately triggered AGX vote and SGX identity reads.
	  A second explicit gate permits a retained UAT/RTKit HELLO experiment.
	  Does not publish GPU work queues or expose a DRM device.
	  Includes the private native-buffer/provider helpers, but creating a
	  visible DRM node still requires separate actual backend qualification.
	  Requires a watchdog guard. No unload, suspend or power-off qualification.
	  Leave disabled for production. May be built alongside DRM_ASAHI:
	  that driver binds other GPUs, this one only apple,agx-t8132 on J713.

config DRM_APPLE_M4_GPU
	tristate "J713 retained GPU Mesa ABI frontend"
	depends on DRM && ARM64 && OF && APPLE_PMP && APPLE_RTKIT
	select DRM_GEM_SHMEM_HELPER
	select DRM_SCHED
	select DRM_EXEC
	help
	  Render-node frontend for the separately qualified, retained J713 GPU
	  owner. Uses the Asahi Mesa userspace ABI without owning a mailbox,
	  firmware table or power domain. Registration and all execution require
	  explicit backend qualification; building this alone starts no firmware.
	  Includes bounded canonical timestamp ownership helpers; these do not
	  authorize timestamp publication, WB admission or DRM registration.
	  This is an intermediate bring-up driver. Leave disabled for production.

config DRM_APPLE
	tristate "DRM Support for Apple display controllers"
	depends on DRM && OF && ARM64
	depends on ARCH_APPLE || COMPILE_TEST
	depends on APPLE_RTKIT
	depends on OF_ADDRESS
	select APPLE_PMP_REPORT
	select DRM_CLIENT_SELECTION
	select DRM_KMS_HELPER
	select DRM_KMS_DMA_HELPER
	select DRM_GEM_DMA_HELPER
	select VIDEOMODE_HELPERS
	depends on BACKLIGHT_CLASS_DEVICE
	select MULTIPLEXER
	help
	  Say Y if you have an Apple Silicon chipset.

config DRM_APPLE_AUDIO
	bool "DisplayPort/HDMI Audio support"
	default y
	depends on DRM_APPLE
	depends on SND
	select SND_PCM
	select SND_DMAENGINE_PCM

config DRM_APPLE_DEBUG
	bool "Enable additional driver debugging"
	depends on DRM_APPLE
	depends on EXPERT # only for developers

config DRM_APPLE_KUNIT_TEST
	tristate "KUnit tests for Apple display controller" if !KUNIT_ALL_TESTS
	depends on KUNIT
	default KUNIT_ALL_TESTS
	help
	  Build tests for the Apple display driver's AFK ring parser and
	  backlight policy (takeover, DPMS, suspend, fades and present
	  completion).
	  The tests cover the header strides used by older firmware and
	  larger rings, as well as malformed ring size combinations.
	  This option is intended for developer test kernels.
	  Also test the Type-C modeset, hotplug and service ownership state.
```

## drivers/net/wireless/mediatek/mt7932/Kconfig
```kconfig
# SPDX-License-Identifier: GPL-2.0-only
config MT7932_FULLMAC
	tristate "Experimental J700 MT7932 fullmac wireless support"
	depends on PCI && OF && ARM64 && IOMMU_DMA
	depends on PCIE_APPLE_PIODMA_DIAG && CFG80211
	select FW_LOADER
	help
	  Native support for the built-in J700 Wi-Fi endpoint: managed
	  WPA2-CCMP station operation on 2.4 GHz and on the 5 GHz UNII-1, -2,
	  -2e and -3 channels that the regulatory domain permits. Radar (DFS)
	  channels are scanned passively but not joined.
	  Requires original firmware, own calibration and original-derived
	  country policy packages in addition to the cfg80211 regulatory database.
	  The device is probed before the root filesystem is mounted, so say M
	  unless those files are in the initramfs.
	  Requires a trained retained PCI link and a translated SID1 DMA domain.
	  Firmware, runtime DMA and calibration negotiation start automatically;
	  cfg80211 and userspace select the country and network. No test boot
	  parameters are required for ordinary station operation.
	  Once DMA pointers are published the module is pinned until hardware
	  reset. Normal unload is refused, including with active Bluetooth.
	  A failed probe reset retains the binding and DMA; a successful checked
	  reset retires ownership before releasing probe resources.
	  Other MediaTek devices and other machines are not matched.

config MT7932_RF_KUNIT_TEST
	bool "KUnit tests for MT7932 terminal RF failure" if !KUNIT_ALL_TESTS
	depends on KUNIT=y && MT7932_FULLMAC
	default KUNIT_ALL_TESTS
	help
	  Exercise the driver's terminal calibration failure and startup
	  admission paths with synthetic devices, without radio hardware.
	  Check association wakeups, retained peer ownership and refusal to
	  reopen RF admission after a terminal calibration error.
```
